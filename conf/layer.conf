## conf/layer.conf
```bitbake
# We have a conf and classes directory, add to BBPATH
BBPATH .= ":${LAYERDIR}"

# We have recipes-* directories, add to BBFILES
BBFILES += "${LAYERDIR}/recipes-*/*/*.bb \
            ${LAYERDIR}/recipes-*/*/*.bbappend"

BBFILE_COLLECTIONS += "meta-ynov-warp7"
BBFILE_PATTERN_meta-ynov-warp7 = "^${LAYERDIR}/"
BBFILE_PRIORITY_meta-ynov-warp7 = "6"

LAYERDEPENDS_meta-ynov-warp7 = "core"
LAYERSERIES_COMPAT_meta-ynov-warp7 = "thud"
```
